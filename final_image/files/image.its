## final_image/files/image.its
```
/dts-v1/;
/ {
  description = "RPi FIT Image";
  #address-cells = <2>;
  images {
    kernel-1 {
      description = "default kernel";
      data = /incbin/("kernel8.img");
      type = "kernel";
      arch = "arm64";
      os = "linux";
      compression = "none";
      load =  <0x06400000>;
      entry = <0x06400000>;
      hash-1 {
        algo = "sha1";
      };
    };
    fdt-1 {
      description = "device tree";
      data = /incbin/("bcm2710-rpi-3-b-plus.dtb");
      type = "flat_dt";
      arch = "arm64";
      compression = "none";
      hash-1 {
        algo = "sha1";
      };
    };
    initramfs {
    	description = "ramsdisk";
    	data = /incbin/("initramfs.cpio");
    	type = "ramdisk";
    	arch = "arm64";
    	os = "linux";
    	compression = "none";
    	hash {
    	  algo = "sha1";
    	};
    };
  };
  configurations {
    default = "config-1";
    config-1 {
      description = "default configuration";
      kernel = "kernel-1";
      fdt = "fdt-1";
      ramdisk = "initramfs";
		  hash-1 {
		  	algo = "sha1";
		  };
      signature-1 {
			required = "image";
        algo = "sha1,rsa2048";
        key-name-hint = "dev";
        sign-images = "fdt", "kernel", "initramfs";
      };
    };
  };
};
```

## image.its
```
/dts-v1/;
/ {
    description = "RPi FIT Image";
    #address-cells = <2>;
    images {
        kernel-1 {
            description = "default kernel";
            data = /incbin/("stage2_u-boot/image/kernel8.img");
            type = "kernel";
            arch = "arm64";
            os = "linux";
            compression = "gzip";
            load =  <0x00080000>;
            entry = <0x00080000>;
            hash-1 {
                algo = "sha1";
            };
        };
        fdt-1 {
            description = "device tree";
            data = /incbin/("stage1_board/rpi3b+/bcm2710-rpi-3-b-plus.dtb");
            type = "flat_dt";
            arch = "arm64";
            compression = "none";
            hash-1 {
                algo = "sha1";
            };
        };
    	ramdisk {
    	        description = "ramsdisk";
    	        data = /incbin/("stage3_initramfs/initramfs.cpio.gz");
    	        type = "ramdisk";
    	        arch = "arm64";
    	        os = "linux";
    	        compression = "gzip";
    	        hash {
    	                algo = "sha1";
    	        };
    	};
    };
    configurations {
        default = "config-1";
        config-1 {
            description = "default configuration";
            kernel = "kernel-1";
            fdt = "fdt-1";
			ramdisk = "ramdisk";
			hash-1 {
				algo = "sha1";
			};
            signature-1 {
				required = "image";
                algo = "sha1,rsa2048";
                key-name-hint = "dev";
                sign-images = "fdt", "kernel", "ramdisk";
            };
        };
    };
};
```
